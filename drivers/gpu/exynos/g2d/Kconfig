## drivers/gpu/exynos/g2d/Kconfig
```kconfig
config EXYNOS_GRAPHICS_G2D
	bool "FIMG2D support"
	help
	  This enables FIMG2D driver of Exynos SoCs.

if EXYNOS_GRAPHICS_G2D

config G2D_FENCE_DEBUG
	bool "FIMG2D fence debugging info"
	depends on EXYNOS_GRAPHICS_G2D
	default n

endif
```

## drivers/video/fbdev/exynos/Kconfig
```kconfig
if SOC_EXYNOS9810

source "drivers/video/fbdev/exynos/dpu_everest/Kconfig"
source "drivers/video/fbdev/exynos/panel/Kconfig"

endif # SOC_EXYNOS9810
```
